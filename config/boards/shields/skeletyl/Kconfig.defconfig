## config/boards/shields/skeletyl/Kconfig.defconfig
```kconfig
if SHIELD_SKELETYL_LEFT

config ZMK_KEYBOARD_NAME
    default "Skeletyl Left"

config ZMK_SPLIT_BLE_ROLE_CENTRAL
    default y

endif

if SHIELD_SKELETYL_RIGHT

config ZMK_KEYBOARD_NAME
    default "Skeletyl Right"

endif

if SHIELD_SKELETYL_LEFT || SHIELD_SKELETYL_RIGHT

config ZMK_SPLIT
    default y

endif
```

## config/boards/shields/skeletyl/Kconfig.shield
```kconfig
# Copyright (c) 2021 Casey Webster
# SPDX-License-Identifier: MIT

config SHIELD_SKELETYL_LEFT
    def_bool $(shields_list_contains,skeletyl_left)

config SHIELD_SKELETYL_RIGHT
    def_bool $(shields_list_contains,skeletyl_right)
```

## config/boards/shields/tbkmini/Kconfig.shield
```kconfig
# Copyright (c) 2022 Casey Webster, Lau Kar Rui
# SPDX-License-Identifier: MIT

config SHIELD_TBKMINI
    bool

config SHIELD_TBKMINI_LEFT
    def_bool $(shields_list_contains,tbkmini_left)
        select SHIELD_TBKMINI

config SHIELD_TBKMINI_RIGHT
    def_bool $(shields_list_contains,tbkmini_right)
        select SHIELD_TBKMINI

config SHIELD_TBKMINI_ADAPTERV2_LEFT
	def_bool $(shields_list_contains,tbkmini_adapterv2_left)
	select SHIELD_TBKMINI

config SHIELD_TBKMINI_ADAPTERV2_RIGHT
	def_bool $(shields_list_contains,tbkmini_adapterv2_right)
	select SHIELD_TBKMINI
```
